## drivers/staging/android/Kconfig
```kconfig
menu "Android"

config ANDROID
	bool "Android Drivers"
	default N
	---help---
	  Enable support for various drivers needed on the Android platform

if ANDROID

config ANDROID_BINDER_IPC
	bool "Android Binder IPC Driver"
	default n

config ANDROID_LOGGER
	tristate "Android log driver"
	default n

config ANDROID_PERSISTENT_RAM
	bool
	depends on HAVE_MEMBLOCK
	select REED_SOLOMON
	select REED_SOLOMON_ENC8
	select REED_SOLOMON_DEC8
	
config ANDROID_RAM_CONSOLE
	bool "Android RAM buffer console"
	depends on !S390 && !UML && HAVE_MEMBLOCK
	select ANDROID_PERSISTENT_RAM
 	default n	

config PERSISTENT_TRACER
	bool "Persistent function tracer"
	depends on HAVE_FUNCTION_TRACER
	select FUNCTION_TRACER
	select ANDROID_PERSISTENT_RAM
	help
	  persistent_trace traces function calls into a persistent ram
	  buffer that can be decoded and dumped after reboot through
	  /sys/kernel/debug/persistent_trace.  It can be used to
	  determine what function was last called before a reset or
	  panic.

config ANDROID_TIMED_OUTPUT
	bool "Timed output class driver"
	default y

config ANDROID_TIMED_GPIO
	tristate "Android timed gpio driver"
	depends on GENERIC_GPIO && ANDROID_TIMED_OUTPUT
	default n

config ANDROID_LOW_MEMORY_KILLER
	bool "Android Low Memory Killer"
	default N
	---help---
	  Register processes to be killed when memory is low

config ANDROID_LOW_MEMORY_KILLER_AUTODETECT_OOM_ADJ_VALUES
	bool "Android Low Memory Killer: detect oom_adj values"
	depends on ANDROID_LOW_MEMORY_KILLER
	default y
	---help---
	  Detect oom_adj values written to
	  /sys/module/lowmemorykiller/parameters/adj and convert them
	  to oom_score_adj values.

config ANDROID_RADIO_LOG_SIZE
	int "THE SIZE OF RADIO LOG FOR STAGING ANDROID LOGGER"
	range 32 512
	default 256
	help
	  Determine the size of radio log - kbytes

config ANDROID_DEVICE_LOG_SIZE
	int "THE SIZE OF DEVICE(MAIN) LOG FOR STAGING ANDROID LOGGER"
	range 32 512
	default 256
	help
	  Determine the size of device log - kbytes

config ANDROID_SYSTEM_LOG_SIZE
	int "THE SIZE OF SYSTEM LOG FOR STAGING ANDROID LOGGER"
	range 32 512
	default 256
	help
		Determine the size of system log - kbytes

config ANDROID_EVENTS_LOG_SIZE
	int "THE SIZE OF EVENTS LOG FOR STAGING ANDROID LOGGER"
	range 32 512
	default 256
	help
		Determine the size of events log - kbytes

endif # if ANDROID

endmenu
```
